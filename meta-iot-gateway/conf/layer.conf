## meta-iot-gateway/conf/layer.conf
```bitbake
# We have a conf and classes directory, add to BBPATH
BBPATH .= ":${LAYERDIR}"

# We have a packages directory, add to BBFILES
BBFILES += "${LAYERDIR}/recipes-*/*/*.bb \
            ${LAYERDIR}/recipes-*/*/*.bbappend"

LAYERSERIES_COMPAT_imx-iot-gateway = "warrior"

BBFILE_COLLECTIONS += "imx-iot-gateway"
BBFILE_PATTERN_imx-iot-gateway := "^${LAYERDIR}"
```
